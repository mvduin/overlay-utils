// configure am335x pruss for uio
// compatible with kernel series 5.4-ti and 5.10-ti
//
// (equivalent to the AM335X-PRU-UIO-00A0 overlay of those kernel series)

&pruss_tm {
	status = "okay";

	// select the 200 MHz core-m4 clock as clock source for the subsystem.
	// this is the default at cold reset, but it's warm-reset-insensitive
	// and not touched by u-boot nor by the kernel unless we explicitly ask
	// it to, so let's select it explicitly just to make sure.
	assigned-clocks		= <&pruss_ocp_gclk>;
	assigned-clock-parents	= <&l3_gclk>;
	assigned-clock-rates	= <0>;
};

&pruss {
	compatible = "ti,pruss-v2";
	ti,pintc-offset = <0x20000>;
	interrupt-parent = <&intc>;
	interrupts = <20 21 22 23 24 25 26 27>;
};
