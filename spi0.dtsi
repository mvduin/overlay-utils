#include "bone/black.h"

// disable conflicting cape-universal nodes

USES_PIN( P9_17 );  // cs 0
USES_PIN( P9_18 );  // data out
USES_PIN( P9_21 );  // data in
USES_PIN( P9_22 );  // clk

USES_SPI( 0, 0 );

// setup pinmux and enable controller

&spi0 {
	status = "okay";

	pinctrl-names = "default";
	pinctrl-0 = <&spi0_pins>;
};

&am33xx_pinmux {
	spi0_pins: spi0 {
		pinctrl-single,pins = <
			PIN_PULLUP( P9_22, 0 )  // clk
			PIN_PULLUP( P9_21, 0 )  // data in
			PIN_PULLUP( P9_18, 0 )  // data out
			PIN_PULLUP( P9_17, 0 )  // cs 0
		>;
	};
};

// declare connected device (example)

&spi0 {
	// NOTE: consider giving the node a descriptive name like flash@0

	spidev@0 {
		reg = <0>;
		compatible = "spidev";

		// create symlink (using /etc/udev/rules.d/10-of-symlink.rules)
		// NOTE: again, consider using something more descriptive
		symlink = "spi/0.0";  // create /dev/spi/0.0 symlink

		// XXX replace by actual max frequency supported by device
		spi-max-frequency = <48000000>;

		// XXX this selects SPI mode 3 by default, adjust as appropriate
		spi-cpol;
		spi-cpha;
	};
};
