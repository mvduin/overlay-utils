#include "bone/black.h"
#include "gpio.h"

USES_PIN( P9_12 );

/ {
	onewire {
		compatible = "w1-gpio";
		gpios = <&gpio1 28 ACTIVE_HIGH>;

		pinctrl-names = "default";
		pinctrl-0 = <&onewire_pin>;
	};
};

&am33xx_pinmux {
	onewire_pin: onewire {
		pinctrl-single,pins = <
			PIN_PULLUP( P9_12, 7 )  // gpio 1.28
		>;
	};
};
