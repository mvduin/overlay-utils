#include "bone/black.h"

USES_PIN( P9_24 );
USES_PIN( P9_26 );

&dcan1 {
	pinctrl-names = "default";
	pinctrl-0 = <&can1_pins>;

	status = "okay";
};

&am33xx_pinmux {
	can1_pins: can1 {
		pinctrl-single,pins = <
			PIN_PULLUP( P9_24, 2 )  // rx
			PIN_PULLUP( P9_26, 2 )  // tx
		>;
	};
};
