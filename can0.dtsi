#include "bone/black.h"

USES_PIN( P9_19 );
USES_PIN( P9_20 );

&dcan0 {
	pinctrl-names = "default";
	pinctrl-0 = <&can0_pins>;

	status = "okay";
};

&am33xx_pinmux {
	can0_pins: can0 {
		pinctrl-single,pins = <
			PIN_PULLUP( P9_19, 2 )  // rx
			PIN_PULLUP( P9_20, 2 )  // tx
		>;
	};
};
