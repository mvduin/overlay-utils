// PWM output on the beaglebone blue

#include "bone/blue.h"
#include "subarctic/pinctrl.h"


//-------- GP0 pin 6 -- eCAP 2 -------------------------------------------------

USES_PIN( P9_28 );

&ecap2 {
	status = "okay";
	pinctrl-names = "default";
	pinctrl-0 = <&ecap2_pins>;
};

&am33xx_pinmux {
	ecap2_pins: ecap2 {
		pinctrl-single,pins = <
			PIN_PULLDN( GP0_6, 4 )
		>;
	};
};
