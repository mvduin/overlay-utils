#include "bone/black.h"

// disable conflicting cape-universal nodes
USES_PIN( P9_24 );  // txd
USES_PIN( P9_26 );  // rxd

// pinmux for module
&am33xx_pinmux {
	uart1_pins: uart1 {
		pinctrl-single,pins = <
			PIN_PULLUP( P9_24, 0 )  // txd
			PIN_PULLUP( P9_26, 0 )  // rxd
		>;
	};
};

// configure and enable module
&uart1 {
	status = "okay";

	pinctrl-names = "default";
	pinctrl-0 = <&uart1_pins>;
};
