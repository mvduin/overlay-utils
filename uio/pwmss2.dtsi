#pragma once
#include "uio.h"

#if ( KERNEL_MAJOR >= 5 )
#define PWMSS2_BASE 0x0
#define PWMSS2_UIO_NODE uio@0
#else
#define PWMSS2_BASE 0x48304000
#define PWMSS2_UIO_NODE uio@48304000
#endif

// make sure subsystem is enabled and make it usable for uio
&epwmss2 {
	status = "okay";

	// ask kernel to keep its clocks enabled at all times
	ti,no-idle;

	// make sure the entire subsystem's range is mapped
	ranges = <PWMSS2_BASE PWMSS2_BASE 0x1000>;

	// the entire subsystem's registers is a single 4K page so we make a
	// uio device for that.  the submodule uio devices are mainly for the
	// irq (with the declared register ranges just being informative).
	PWMSS2_UIO_NODE {
		reg = <PWMSS2_BASE 0x1000>;

		compatible = UIO_COMPATIBLE;
		symlink = "uio/pwmss2/module";
	};
};
