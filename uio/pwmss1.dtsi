#pragma once
#include "uio.h"

#if ( KERNEL_MAJOR >= 5 )
#define PWMSS1_BASE 0x0
#define PWMSS1_UIO_NODE uio@0
#else
#define PWMSS1_BASE 0x48302000
#define PWMSS1_UIO_NODE uio@48302000
#endif

// make sure subsystem is enabled and make it usable for uio
&epwmss1 {
	status = "okay";

	// ask kernel to keep its clocks enabled at all times
	ti,no-idle;

	// make sure the entire subsystem's range is mapped
	ranges = <PWMSS1_BASE PWMSS1_BASE 0x1000>;

	// the entire subsystem's registers is a single 4K page so we make a
	// uio device for that.  the submodule uio devices are mainly for the
	// irq (with the declared register ranges just being informative).
	PWMSS1_UIO_NODE {
		reg = <PWMSS1_BASE 0x1000>;

		compatible = UIO_COMPATIBLE;
		symlink = "uio/pwmss1/module";
	};
};
