#include "bone/black.h"

// disable conflicting cape-universal nodes
USES_PIN( P9_21 );  // txd
USES_PIN( P9_22 );  // rxd

// pinmux for module
&am33xx_pinmux {
	uart2_pins: uart2 {
		pinctrl-single,pins = <
			PIN_PULLUP( P9_21, 1 )  // txd
			PIN_PULLUP( P9_22, 1 )  // rxd
		>;
	};
};

// configure and enable module
&uart2 {
	status = "okay";

	pinctrl-names = "default";
	pinctrl-0 = <&uart2_pins>;
};
