// configure am572x pruss2 for uio
// compatible with kernel series 4.14-ti and 4.19-ti

&pruss_soc_bus2 {
	status = "okay";
	compatible = "simple-pm-bus", "ti,am5728-pruss-soc-bus";
};

&pruss2 {
	compatible = "ti,pruss-v2";
	ti,pintc-offset = <0x20000>;
	pruss-instance = "pruss2";
};
