// configure am572x pruss2 for uio
// compatible with kernel series 5.4-ti and 5.10-ti

#include "am57xx/irq.h"

&pruss2_tm {
	status = "okay";
};

&pruss2 {
	compatible = "ti,pruss-v2";
	ti,pintc-offset = <0x20000>;
	interrupts = <GIC_SPI 196 IRQ_TYPE_LEVEL_HIGH>,
		     <GIC_SPI 197 IRQ_TYPE_LEVEL_HIGH>,
		     <GIC_SPI 198 IRQ_TYPE_LEVEL_HIGH>,
		     <GIC_SPI 199 IRQ_TYPE_LEVEL_HIGH>,
		     <GIC_SPI 200 IRQ_TYPE_LEVEL_HIGH>,
		     <GIC_SPI 201 IRQ_TYPE_LEVEL_HIGH>,
		     <GIC_SPI 202 IRQ_TYPE_LEVEL_HIGH>,
		     <GIC_SPI 203 IRQ_TYPE_LEVEL_HIGH>;
	pruss-instance = "pruss2";
};
