// configure both pruss instances for uio
// compatible with kernel series 4.14-ti and 4.19-ti
//
// NOTE: libprussdrv can only use the first pruss instance, py-uio can use both.

#include "uio-pruss1-4.14.dtsi"
#include "uio-pruss2-4.14.dtsi"
