// configure am572x pruss1 for uio
// compatible with kernel series 5.4-ti and 5.10-ti

#include "am57xx/irq.h"

&pruss1_tm {
	status = "okay";
};

&pruss1 {
	compatible = "ti,pruss-v2";
	ti,pintc-offset = <0x20000>;
	interrupts = <GIC_SPI 186 IRQ_TYPE_LEVEL_HIGH>,
		     <GIC_SPI 187 IRQ_TYPE_LEVEL_HIGH>,
		     <GIC_SPI 188 IRQ_TYPE_LEVEL_HIGH>,
		     <GIC_SPI 189 IRQ_TYPE_LEVEL_HIGH>,
		     <GIC_SPI 190 IRQ_TYPE_LEVEL_HIGH>,
		     <GIC_SPI 191 IRQ_TYPE_LEVEL_HIGH>,
		     <GIC_SPI 192 IRQ_TYPE_LEVEL_HIGH>,
		     <GIC_SPI 193 IRQ_TYPE_LEVEL_HIGH>;
	pruss-instance = "pruss1";
};
