&ocp {
	debugss: debugss@4b000000 {
		ti,hwmods = "debugss";
		ti,no-idle-on-init;
		ti,no-idle;  // keep it enabled
		compatible = "simple-bus";
		#address-cells = <1>;
		#size-cells = <1>;
		ranges;
	};
};
