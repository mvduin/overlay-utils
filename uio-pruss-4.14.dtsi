// configure am335x pruss for uio
// compatible with kernel series 4.14-ti and 4.19-ti only
//
// (similar in purpose to AM335X-PRU-UIO-00A0 but implemented differently)

&pruss_soc_bus {
	status = "okay";
	compatible = "simple-pm-bus", "ti,am3356-pruss-soc-bus";
	ti,deassert-hard-reset = "pruss", "pruss";

	// select the 200 MHz core-m4 clock as clock source for the subsystem.
	// this is the default at cold reset, but it's warm-reset-insensitive
	// and not touched by u-boot nor by the kernel unless we explicitly ask
	// it to, so let's select it explicitly just to make sure.
	assigned-clocks		= <&pruss_ocp_gclk>;
	assigned-clock-parents	= <&l3_gclk>;
	assigned-clock-rates	= <0>;
};

&pruss {
	status = "okay";
	compatible = "ti,pruss-v2";
	ti,pintc-offset = <0x20000>;
};
