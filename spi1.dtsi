#include "bone/black.h"

// disable conflicting cape-universal nodes

USES_PIN( P9_31 );  // clk
USES_PIN( P9_29 );  // data in
USES_PIN( P9_30 );  // data out
USES_PIN( P9_28 );  // cs 0
#if SPI1_DUAL_CS
USES_PIN( P9_42 );  // cs 1
USES_PIN( P9_92 );  // (disable shared pin)
#endif

USES_SPI( 1, 0 );
#if SPI1_DUAL_CS
USES_SPI( 1, 1 );
#endif

// setup pinmux and enable controller

&spi1 {
	status = "okay";

	pinctrl-names = "default";
	pinctrl-0 = <&spi1_pins>;
};

&am33xx_pinmux {
	spi1_pins: spi1 {
		pinctrl-single,pins = <
			PIN_PULLUP( P9_31, 3 )  // clk
			PIN_PULLUP( P9_29, 3 )  // data in
			PIN_PULLUP( P9_30, 3 )  // data out
			PIN_PULLUP( P9_28, 3 )  // cs 0
#if SPI1_DUAL_CS
			PIN_PULLUP( P9_42a,2 )  // cs 1
			PIN_NOPULL( P9_42b,7 )  // (disable shared pin)
#endif
		>;
	};
};
